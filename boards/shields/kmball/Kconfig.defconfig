## boards/shields/kmball/Kconfig.defconfig
```kconfig
if SHIELD_KMBALL_LEFT

config ZMK_KEYBOARD_NAME
    default "kmball"

endif

if SHIELD_KMBALL_LEFT || SHIELD_KMBALL_RIGHT

config ZMK_SPLIT
    default y

endif
```

## boards/shields/kmball/Kconfig.shield
```kconfig
config SHIELD_KMBALL_LEFT
    def_bool $(shields_list_contains,kmball_left)
config SHIELD_KMBALL_RIGHT
    def_bool $(shields_list_contains,kmball_right)
```
